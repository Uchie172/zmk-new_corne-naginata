## config/west.yml
```yaml
# =============================================================================
# ZMK West Manifest
# =============================================================================
#
# ZMK本体および追加モジュールの取得元・バージョンを定義するファイル。
#
# west update 実行時やGitHub Actionsでのビルド時に、
# ここで指定したリポジトリから必要なソースコードが取得される。
#
# revision は使用するブランチまたはバージョンを指定する。
# 不用意に変更するとビルドやモジュール間の互換性に影響するため注意。
# =============================================================================

manifest:

  # ===========================================================================
  # Remote Repository
  # ===========================================================================
  #
  # projectsで使用するGitHubリポジトリの取得元を定義する。
  #
  # zmkfirmware : ZMK公式
  # cormoran     : DYA等の機能を含むZMK forkおよび追加モジュール
  # eswai        : 薙刀式（Naginata）入力用モジュール
  #
  remotes:
    - name: zmkfirmware
      url-base: https://github.com/zmkfirmware

    - name: cormoran
      url-base: https://github.com/cormoran

    - name: eswai
      url-base: https://github.com/eswai


  # ===========================================================================
  # Projects
  # ===========================================================================
  #
  # ビルド時に取得するZMK本体・Shield・追加モジュールを定義する。
  #
  projects:

    # -------------------------------------------------------------------------
    # Eyelash Corne
    # -------------------------------------------------------------------------
    #
    # 現在使用しているCorne用Shield定義の取得元。
    # 現在値：mainブランチを使用。
    #
    - name: eyelash_corne
      url: https://github.com/a741725193/zmk-new_corne
      revision: main


    # -------------------------------------------------------------------------
    # ZMK Firmware
    # -------------------------------------------------------------------------
    #
    # ZMK本体。
    # ZMK公式版ではなく、cormoran氏のforkを使用する。
    #
    # 現在値：v0.3-branch+dya
    #
    # DYA関連機能や、以下で使用しているcormoran系モジュールとの
    # 互換性に関係するため、revision変更時は注意する。
    #
    - name: zmk
      remote: cormoran
      revision: v0.3-branch+dya
      import: app/west.yml


    # -------------------------------------------------------------------------
    # Runtime Sensor Rotate
    # -------------------------------------------------------------------------
    #
    # センサーの回転動作を実行時に扱うための追加Behavior。
    # ロータリーエンコーダ等のセンサー入力処理に使用する。
    #
    # 現在値：mainブランチ
    #
    - name: zmk-behavior-runtime-sensor-rotate
      remote: cormoran
      revision: main


    # -------------------------------------------------------------------------
    # BLE Management
    # -------------------------------------------------------------------------
    #
    # Bluetooth接続を管理するための追加モジュール。
    #
    # 現在値：zmk-v0.3.0.0
    #
    - name: zmk-module-ble-management
      remote: cormoran
      revision: zmk-v0.3.0.0


    # -------------------------------------------------------------------------
    # Battery History
    # -------------------------------------------------------------------------
    #
    # バッテリー情報の履歴を扱うための追加モジュール。
    # バッテリー状態の表示・管理機能で利用する。
    #
    # 現在値：mainブランチ
    #
    - name: zmk-module-battery-history
      remote: cormoran
      revision: main


    # -------------------------------------------------------------------------
    # Settings RPC
    # -------------------------------------------------------------------------
    #
    # ZMKの設定情報をRPC経由で扱うための追加モジュール。
    #
    # 現在値：mainブランチ
    #
    - name: zmk-module-settings-rpc
      remote: cormoran
      revision: main


    # -------------------------------------------------------------------------
    # Runtime Input Processor
    # -------------------------------------------------------------------------
    #
    # ポインティングデバイス等の入力を実行時に加工するための
    # Input Processor機能を追加するモジュール。
    #
    # 現在値：zmk-v0.3.0.0
    #
    - name: zmk-module-runtime-input-processor
      remote: cormoran
      revision: zmk-v0.3.0.0


    # -------------------------------------------------------------------------
    # Naginata
    # -------------------------------------------------------------------------
    #
    # 薙刀式（Naginata）入力をZMKで使用するためのモジュール。
    #
    # 現在値：mainブランチ
    #
    - name: zmk-naginata
      remote: eswai
      revision: main


  # ===========================================================================
  # Self
  # ===========================================================================
  #
  # このZMK Configリポジトリ自身の設定。
  #
  # path: config
  # → ZMKのユーザー設定をconfigディレクトリから読み込む。
  #
  self:
    path: config
```
